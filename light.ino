#include <Sodaq_RN2483.h>
#define debugSerial SerialUSB
#define loraSerial  Serial2

// Variables will contain your personal OTAA Activation Keys
uint8_t devEUI[8] ;   // Device EUI
uint8_t appEUI[8] ;   // App EUI
uint8_t appKey[16] ;  // App Key
const uint8_t appKeyPrefix[8] = {0xFF, 0xEE, 0xDD, 0xCC, 0xBB, 0xAA, 0x99, 0x88} ;

// Step 2 Replace here the 00’s by your appEUI generated by TTN
const uint8_t appEUIfromTTN[8] = { 0x70, 0xB3, 0xD5, 0x7E, 0xF0, 0x00, 0x5E, 0xBE } ;

const uint8_t devAddr[4] = 
{
  0x00, 0x1E, 0xE2, 0x7F
};

const uint8_t appSKey[16] =
{
  0x00, 0x01, 0x01, 0x01,
  0x00, 0x00, 0x00, 0x90,
  0x00, 0x00, 0x00, 0x05,
  0x00, 0x00, 0x00, 0x00
};

const uint8_t nwkSKey[16] =
{
  0x00, 0x00, 0x00, 0x01,
  0x00, 0x00, 0x00, 0x00,
  0x00, 0x30, 0x20, 0x00,
  0x00, 0x00, 0x90, 0x00
};

void setup()
{
  while (!debugSerial && (millis() < 10000)) ;
	debugSerial.begin(115200) ;
  debugSerial.println("Microchip Technology ExpLoRer Starter Kit") ;
  debugSerial.println("21080_IoT3 Masters 2017 Class") ;
  debugSerial.println("Lab 3") ;

  // --------------------------------------------------------------------------
  // Init section
  // --------------------------------------------------------------------------
  // Temperature sensor
  pinMode(TEMP_SENSOR, INPUT) ;
  analogReadResolution(12) ;

  // LED
  pinMode(LED_BUILTIN, OUTPUT) ;
  pinMode(LED_RED, OUTPUT) ;
  pinMode(LED_GREEN, OUTPUT) ; 
  pinMode(LED_BLUE, OUTPUT) ;

  // LoRa
  loraSerial.begin(LoRaBee.getDefaultBaudRate());

  // --------------------------------------------------------------------------
  // Display activation keys section
  // --------------------------------------------------------------------------
  debugSerial.println("") ;
  debugSerial.print("devEUI = ") ;
  displayArrayInOneLine(devEUI, sizeof(devEUI)) ;

  // --------------------------------------------------------------------------
  // Network Activation section
  // --------------------------------------------------------------------------

  setRgbColor(0x00, 0x00, 0xFF) ;
  debugSerial.println("Try to join the LoRa network through OTA Activation") ;
  if (!LoRaBee.initABP(loraSerial, devAddr, appSKey, nwkSKey, true))
  {
    debugSerial.println("Connection to the network failed!");
    return;
  }
}

void loop()
{
  int sensorValue = analogRead(TEMP_SENSOR) ;
  float mVolts = (float)sensorValue * 3300 / 4096.0 ;
  float temp = (mVolts - 500) ;
  temp = temp / 10.0 ;
  debugSerial.println(temp) ;
  delay(3000) ;
  uint8_t res = NoResponse ;
  // Step 5.1 Create the payload variable
  char payload[10] ;
  // Step 5.2 Fill the payload with temperature value
  sprintf(payload, "%.2f", temp) ;
  // Step 5.3 Send a confirmed uplink message
  res = LoRaBee.sendReqAck(2, (const uint8_t*)payload, strlen(payload), 3) ;
  switch (res)
  {
    case NoError:
      debugSerial.println("Successful transmission.") ;
      setRgbColor(0x00, 0xFF, 0x00) ;
      delay(2000) ;
      setRgbColor(0x00, 0x00, 0x00) ;
      break;
    case NoResponse:
      debugSerial.println("There was no response from the device.") ;
      setRgbColor(0xFF, 0x00, 0x00) ;
      break ;
    case Timeout:
      debugSerial.println("Connection timed-out. Check your serial connection to the device! Sleeping for 20sec.") ;
      setRgbColor(0xFF, 0x00, 0x00) ;
      delay(20000) ;
      break ;
    case PayloadSizeError:
      debugSerial.println("The size of the payload is greater than allowed. Transmission failed!") ;
      setRgbColor(0xFF, 0x00, 0x00) ;
      break ;
    case InternalError:
      debugSerial.println("Oh No! This shouldn't happen. Something is really wrong! Try restarting the device!\r\nThe program will now halt.") ;
      setRgbColor(0xFF, 0x00, 0x00) ;
      while (1) {} ;
      break ;
    case Busy:
      debugSerial.println("The device is busy. Sleeping for 10 extra seconds.");
      delay(10000) ;
      break ;
    case NetworkFatalError:
      debugSerial.println("There is a non-recoverable error with the network connection. You should re-connect.\r\nThe program will now halt.");
      setRgbColor(0xFF, 0x00, 0x00) ;
      while (1) {} ;
      break ;
    case NotConnected:
      debugSerial.println("The device is not connected to the network. Please connect to the network before attempting to send data.\r\nThe program will now halt.");
      setRgbColor(0xFF, 0x00, 0x00) ;
      while (1) {} ;
      break ;
    case NoAcknowledgment:
      debugSerial.println("There was no acknowledgment sent back!");
      setRgbColor(0xFF, 0x00, 0x00) ;
      break ;
    default:
      break ;
  }
  // Step 5.4 Add a 20 sec delay before restarting the loop()
  delay(20000) ;
}

// --------------------------------------------------------------------------
// Display array in HEX format routine
// --------------------------------------------------------------------------
void displayArrayInOneLine(const uint8_t tab[], uint8_t tabSize)
{
  char c[2] ;
  for (uint8_t i = 0; i < tabSize; i++)
  {
    sprintf(c, "%02X", tab[i]) ;
    debugSerial.print(c) ;
  }
  debugSerial.println("") ;
}

// --------------------------------------------------------------------------
// LED routines
// --------------------------------------------------------------------------
#define COMMON_ANODE  // LED driving method
void setRgbColor(uint8_t red, uint8_t green, uint8_t blue)
{
  #ifdef COMMON_ANODE
    red = 255 - red ;
    green = 255 - green ;
    blue = 255 - blue ;
  #endif
  analogWrite(LED_RED, red) ;
  analogWrite(LED_GREEN, green) ;
  analogWrite(LED_BLUE, blue) ;  
}

void turnBlueLedOn()
{
  digitalWrite(LED_BUILTIN, HIGH) ;
}

void turnBlueLedOff()
{
  digitalWrite(LED_BUILTIN, LOW) ;
}
